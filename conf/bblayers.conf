## conf/bblayers.conf
```bitbake
# LAYER_CONF_VERSION is increased each time build/conf/bblayers.conf
# changes incompatibly
LCONF_VERSION = "6"

BBPATH = "${TOPDIR}"
BBFILES ?= ""

BBLAYERS ?= " \
  /source/iotdk/meta \
  /source/iotdk/meta-yocto \
  /source/iotdk/meta-yocto-bsp \
  /source/iotdk/meta-oe/meta-oe \
  /source/iotdk/meta-oe/meta-filesystems \
  /source/iotdk/meta-intel-quark \
  /source/iotdk/meta-intel-galileo \
  /source/iotdk/meta-intel-iot-middleware \
  /source/iotdk/meta-intel-iot-devkit \
  /source/iotdk/meta-java"
BBLAYERS_NON_REMOVABLE ?= " \
  /source/iotdk/meta \
  /source/iotdk/meta-yocto \
  "
```
